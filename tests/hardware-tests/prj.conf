## CMakeLists.txt
```
cmake_minimum_required(VERSION 3.20.0)
find_package(Zephyr REQUIRED HINTS $ENV{ZEPHYR_BASE})
project(hardware_tests)

set(env_node_id $ENV{NODE_ID})
if(NOT DEFINED ENV{NODE_ID})
    set(env_node_id 666)
    message("Using debug NODE ID : ${env_node_id}")
else()
    message(WARNING "Using NODE ID ${env_node_id} for testing !")
endif()




zephyr_compile_definitions(NODE_ID=${env_node_id})
zephyr_compile_definitions("SASTRESS_LOG_LVL=LOG_LVL_DBG")

FILE(GLOB app_sources src/*.c)
target_sources(app PRIVATE ${app_sources})
target_sources(app PRIVATE ../../src/app_adc.c)
target_sources(app PRIVATE ../../src/app_sht31.c)
target_sources(app PRIVATE ../../src/app_ds3231.c)
target_sources(app PRIVATE ../../src/lorawan.c)
target_include_directories(app PRIVATE ../../src/)
```

## prj.conf
```kconfig
CONFIG_ZTEST=y
CONFIG_ZTEST_STACK_SIZE=4096
# CONFIG_ZTEST_NEW_API=y
# Debugger Support
CONFIG_CONSOLE=y
CONFIG_SERIAL=y
CONFIG_UART_CONSOLE=n
CONFIG_CONSOLE_SUBSYS=y
#CONFIG_CONSOLE_GETLINE=y

# RTT Segger Support
CONFIG_PRINTK=y
CONFIG_RTT_CONSOLE=y
CONFIG_USE_SEGGER_RTT=y


# Add any sensor or driver configs your code needs to compile here
# test_adc
CONFIG_ADC=y

# test_sensor
CONFIG_SENSOR=y

# test_rtc
CONFIG_I2C=y
CONFIG_COUNTER=y
CONFIG_COUNTER_MAXIM_DS3231=y
CONFIG_POSIX_API=y
CONFIG_NEWLIB_LIBC=y

# test_lorawan
# LoRa Support
CONFIG_LORA=y

# LoRaWAN Support
CONFIG_LORAWAN=y
CONFIG_HAS_SEMTECH_LORAMAC=y
CONFIG_LORAMAC_REGION_EU868=y
CONFIG_LORAWAN_SYSTEM_MAX_RX_ERROR=10
CONFIG_MAIN_STACK_SIZE=4096
CONFIG_SYSTEM_WORKQUEUE_STACK_SIZE=4096
```

## src/test_adc.c
```c
#include <zephyr/ztest.h>
#include "app_adc.h"
#include "app_sta_lta_tx.h"

ZTEST(adc_test, test_battery)
{   
    int16_t prev = app_adc_get_bat();
    for (int i = 0; i < 10; i++)
    {
        int16_t volt = app_adc_get_bat();
        zassert_not_equal(volt, 0, "Battery voltage is zero ! Is the battery connected ?");
        zassert_within(volt, 4000, 1000, "Battery voltage is not within the 3000-5000mV range !");
        zassert_within(volt, prev, 50, "Battery voltage fluctuates more than 50mV");
        prev = volt;
    }
}

ZTEST(adc_test, test_sample_one_by_one)
{
    app_adc_sampling_start();
    uint16_t samples[10];
    uint16_t sample;

    int64_t t_start = k_uptime_get();
    for (int i = 0; i < 10; i++)
    {
        k_sem_take(&data_ready_sem, K_FOREVER);
        app_adc_get_buffer(&sample, 1, -1);
        samples[i] = sample;
    }
    int64_t t_end = k_uptime_get();
    app_adc_sampling_stop();

    float sum = 0.0f;
    for (int i = 0; i < 10; i++)
    {
        uint16_t s = samples[i];
        zassert(s > 0, "Measured sensor voltage is zero !");
        zassert(s < 4090, "Measured sensor voltage is above 4090 !");
        sum += (float) s;
    }
    zassert_within(sum/10, 1700, 500, "Error, the signal recorded is not centered around 1700mV ! Average is %u", (uint16_t) (sum/10));
    zassert_within(t_end - t_start, SAMPLING_RATE_MS * 9.8, SAMPLING_RATE_MS * 10.5, "Took longer than expected");
}

uint16_t samples[LTA_WINDOW_SIZE];

ZTEST(adc_test, test_samples)
{   
    printk("Lauching LTA test : It will take a few seconds, please wait\n");
    for(int i = 0; i < LTA_WINDOW_SIZE; i ++) {
        samples[i] = 0;
    }
    app_adc_sampling_start();

    int64_t t_start = k_uptime_get();
    // Wait until at the LTA window is full
    for (int i = 0; i < LTA_WINDOW_SIZE; i++)
    {
        k_sem_take(&data_ready_sem, K_FOREVER);
    }
    int64_t t_end = k_uptime_get();
    zassert_within(t_end - t_start, LTA_WINDOW_SIZE * SAMPLING_RATE_MS * 0.99, LTA_WINDOW_SIZE * SAMPLING_RATE_MS * 10.5, "Took longer than expected");

    k_sem_take(&data_ready_sem, K_FOREVER);
    app_adc_get_buffer(samples, LTA_WINDOW_SIZE, -LTA_WINDOW_SIZE);

     app_adc_sampling_stop();

    float sum = 0;
    for (int i = 0; i < LTA_WINDOW_SIZE; i++)
    {
        uint16_t s = samples[i];
        sum += s;
        zassert(s > 0, "Measured sensor voltage is zero !");
        zassert(s < 4090, "Measured sensor voltage is above 4090 !");
    }
    zassert_within(sum/ LTA_WINDOW_SIZE, 1700, 1000, "Measured sensor voltage is not within the range 700/2700 : %u", (uint16_t) sum/ LTA_WINDOW_SIZE);
}

// Setup the test suite
ZTEST_SUITE(adc_test, NULL, NULL, NULL, NULL, NULL);
```

## src/test_lorawan.c
```c
#include <zephyr/ztest.h>
#include "lorawan.h"
#include "data_types.h"

ZTEST(lorawan_test, test_init_join){
    int ret = lora_init();
    zassert(ret == 0, "Error, could not initialize lora");
    ret = lora_joinnet();
    zassert(ret == 0, "Error, could not join a lorawan network");
}

// Disabled for now, as if the test fail, it stays forever in the function, and we cannot test the other features...
// ZTEST(lorawan_test, test_send){
//     struct bth_payload_t payload;
//     payload.battery = 1;
//     payload.temperature = 2;
//     payload.humidity = 3;

//     int ret = lora_send_packet(BTH, (uint8_t *) &payload, sizeof(struct bth_payload_t));


//     zassert(ret == 0, "Something wrong happened when trying to send a message !");
//     printk("BTH Lora message sent !\nExpected JSON decoded message is :\n");
// }

ZTEST_SUITE(lorawan_test, NULL, NULL, NULL, NULL, NULL);
```

## src/test_rtc.c
```c
#include <zephyr/ztest.h>
#include "app_ds3231.h"

ZTEST(rtc_test, test_no_delay)
{   
    const struct device * dev  = app_ds3231_init();
    zassert(app_ds3231_set_time(dev, 1784133987) == 0, "Failed to set RTC time !");
    uint64_t time = app_get_timestamp();
    printk("Time is %llu \n", time);
    zassert_within(time, 1784133987000, 1500);
}

ZTEST(rtc_test, test_delay)
{   
    const struct device * dev  = app_ds3231_init();
    printk("Lauching RTC test : It will take a few seconds, please wait\n");
    zassert(app_ds3231_set_time(dev, 1784133987) == 0, "Failed to set RTC time !");
    k_sleep(K_SECONDS(10));
    uint64_t time = app_get_timestamp();
    printk("Time is %llu \n", time);
    zassert_within(time, 1784133997000, 1500);
}




ZTEST_SUITE(rtc_test, NULL, NULL, NULL, NULL, NULL);
```

## src/test_sensor.c
```c
#include <zephyr/ztest.h>
#include "app_sensors.h"

ZTEST(sensor_test, test_temperature)
{   
    const struct device *dev = DEVICE_DT_GET_ONE(sensirion_sht3xd);
    zassert(device_is_ready(dev), "Could not get sensor Sensirion SHT3XD");
    k_sleep(K_SECONDS(1));
    int16_t temp = app_sht_get_temp(dev);
    zassert_within(temp, 2500, 2500);

    // Must wait before checking the temperature again, otherwise it result in an error
    k_sleep(K_SECONDS(1));
    // Check variability
    int16_t prev = app_sht_get_temp(dev);
    for(int i =0; i < 10; i++) {
        k_sleep(K_SECONDS(1));
        int16_t temp = app_sht_get_temp(dev);
        zassert_within(temp, 2500, 2500);
        zassert_within(temp, prev, 100);
        prev = temp; 
    }
}

ZTEST(sensor_test, test_humidity)
{   
    const struct device *dev = DEVICE_DT_GET_ONE(sensirion_sht3xd);
    zassert(device_is_ready(dev), "Could not get sensor Sensirion SHT3XD");
    int16_t hum = app_sht_get_hum(dev);
    zassert(hum < 10000 && hum > 1000, "Humidity not in the range 10, 100");
}


// Setup the test suite
ZTEST_SUITE(sensor_test, NULL, NULL, NULL, NULL, NULL);
```
